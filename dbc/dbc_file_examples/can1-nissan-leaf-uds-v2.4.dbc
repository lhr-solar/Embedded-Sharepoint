VERSION ""

NS_ :

BS_:

BU_:

BO_ 1979 BatteryAndTemp: 54 Vector__XXX
 SG_ SoC m1 : 279|24@0+ (0.0001,0) [0|0] "%" Vector__XXX
 SG_ BatPackTemp1 m4 : 40|8@1+ (1,0) [0|0] "%" Vector__XXX
 SG_ BatPackTemp2 m4 : 64|8@1+ (1,0) [0|0] "%" Vector__XXX
 SG_ BatPackTemp4 m4 : 112|8@1+ (1,0) [0|0] "%" Vector__XXX
 SG_ R m97M : 16|8@1+ (1,0) [0|0] "" Vector__XXX
 SG_ S M : 8|8@1+ (1,0) [0|0] "" Vector__XXX

BA_DEF_ SG_  "SignalIgnore" INT 0 1;
BA_DEF_ BO_  "VFrameFormat" ENUM  "StandardCAN","ExtendedCAN","StandardCAN_FD","ExtendedCAN_FD","J1939PG";
BA_DEF_ BO_  "TransportProtocolType" STRING ;
BA_DEF_  "BusType" STRING ;
BA_DEF_  "ProtocolType" STRING ;
BA_DEF_  "DatabaseCompiler" STRING ;
BA_DEF_DEF_  "SignalIgnore" 0;
BA_DEF_DEF_  "VFrameFormat" "";
BA_DEF_DEF_  "TransportProtocolType" "";
BA_DEF_DEF_  "BusType" "";
BA_DEF_DEF_  "ProtocolType" "";
BA_DEF_DEF_  "DatabaseCompiler" "CSS Electronics (wwww.csselectronics.com)";
BA_ "BusType" "CAN";
BA_ "ProtocolType" "OBD";
BA_ "VFrameFormat" BO_ 1979 0;
BA_ "SignalIgnore" SG_ 1979 R 1;
BA_ "SignalIgnore" SG_ 1979 S 1;
BA_ "TransportProtocolType" BO_ 1979 "ISOTP";

SG_MUL_VAL_ 1979 SoC R 1-1;
SG_MUL_VAL_ 1979 BatPackTemp1 R 4-4;
SG_MUL_VAL_ 1979 BatPackTemp2 R 4-4;
SG_MUL_VAL_ 1979 BatPackTemp4 R 4-4;
SG_MUL_VAL_ 1979 R S 97-97;
