VERSION ""

NS_ :

BS_:

BU_:

BO_ 1689 _699: 8 Vector__XXX
 SG_ Temperature : 15|8@0+ (0.5,0) [0|0] "degC" Vector__XXX

BO_ 390 _186: 8 Vector__XXX
 SG_ EngineRPM : 7|16@0+ (0.125,0) [0|0] "RPM" Vector__XXX

BO_ 1495 _5d7: 8 Vector__XXX
 SG_ Speed : 7|16@0+ (0.01,0) [0|0] "km/h" Vector__XXX
 SG_ Odometer : 31|27@0+ (1,0) [0|0] "km" Vector__XXX

BO_ 666 _29a: 8 Vector__XXX
 SG_ VehicleSpeed : 39|16@0+ (0.01,0) [0|0] "km/h" Vector__XXX

BA_DEF_  "BusType" STRING ;
BA_DEF_DEF_  "BusType" "CAN";
