VERSION ""

NS_ :

BS_:

BU_: BPS_LVBatteryMonitor Controls_MotorCommander Telemetry_Leader TPEE_MPPT_B Prohelion_WaveSculptor22 TPEE_MPPT_A Power_Precharge Controls_DriverUserInterface BPS_Leader
VAL_TABLE_ Generic_Active 1 "Active" 0 "Inactive" ;
VAL_TABLE_ BPS_Fault 11 "MPPT" 10 "E-STOP/Contactor" 9 "IsoSPI" 8 "Watchdog" 7 "OS" 6 "Handler" 5 "Open Wire" 4 "Over Current" 3 "Over Temperature" 2 "Overvoltage" 1 "Undervoltage" 0 "None" ;
VAL_TABLE_ Contactor_State 1 "Closed" 0 "Open" ;
VAL_TABLE_ Generic_EN 1 "Enabled" 0 "Disabled" ;
VAL_TABLE_ MPPT_Fault 6 "Fault" 5 "Temperature De-rating" 4 "Constant Output Current" 3 "Constand Output Voltage" 2 "Minimum Input Current" 1 "Constand Input Current" 0 "Constand Input Voltage" ;
VAL_TABLE_ MPPT_Mode 8 "Fault" 7 "Phase Over Current" 6 "Input Under Current" 5 "Input Over Current" 4 "Output Over Current" 3 "Output Over Voltage" 2 "Input Over Voltage" 1 "Configuration Error" 0 "OK(No Fault)" ;

BO_ 1026 MC_PowerCommand: 4 Controls_MotorCommander
 SG_ MC_MotorPowerSetpoint : 0|32@1- (1,0) [0|1] "%"  Prohelion_WaveSculptor22

BO_ 1056 MC_Info: 8 Prohelion_WaveSculptor22
 SG_ MC_TritiumID : 0|32@1+ (1,0) [0|0] "" Vector__XXX
 SG_ MC_SerialNumber : 32|32@1+ (1,0) [0|0] "" Vector__XXX

BO_ 1057 MC_Status: 8 Prohelion_WaveSculptor22
 SG_ MC_LIMIT_Reserved : 7|9@1+ (1,0) [0|511] "On / Off" Vector__XXX
 SG_ MC_LIMIT_MotorTemp : 6|1@1+ (1,0) [0|1] "On / Off" Vector__XXX
 SG_ MC_LIMIT_BusVoltageLower : 5|1@1+ (1,0) [0|1] "On / Off" Vector__XXX
 SG_ MC_LIMIT_BusVoltageUpper : 4|1@1+ (1,0) [0|1] "On / Off" Vector__XXX
 SG_ MC_LIMIT_BusCurrent : 3|1@1+ (1,0) [0|1] "On / Off" Vector__XXX
 SG_ MC_LIMIT_Velocity : 2|1@1+ (1,0) [0|1] "On / Off" Vector__XXX
 SG_ MC_LIMIT_MotorCurrent : 1|1@1+ (1,0) [0|1] "On / Off" Vector__XXX
 SG_ MC_LIMIT_OutputVoltagePWM : 0|1@1+ (1,0) [0|1] "On / Off" Vector__XXX
 SG_ MC_FAULT_Reserved : 25|7@1+ (1,0) [0|0] "On / Off" Vector__XXX
 SG_ MC_FAULT_MotorOverSpeed : 24|1@1+ (1,0) [0|1] "On / Off" Vector__XXX
 SG_ MC_FAULT_DesaturationFault : 23|1@1+ (1,0) [0|1] "On / Off" Vector__XXX
 SG_ MC_FAULT_15vRailUnderVoltage : 22|1@1+ (1,0) [0|1] "On / Off" Vector__XXX
 SG_ MC_FAULT_ConfigRead : 21|1@1+ (1,0) [0|1] "On / Off" Vector__XXX
 SG_ MC_FAULT_WatchdogCausedLastReset : 20|1@1+ (1,0) [0|1] "On / Off" Vector__XXX
 SG_ MC_FAULT_BadMotorPositionHallSeq : 19|1@1+ (1,0) [0|1] "On / Off" Vector__XXX
 SG_ MC_FAULT_DcBusOverVoltage : 18|1@1+ (1,0) [0|1] "On / Off" Vector__XXX
 SG_ MC_FAULT_SoftwareOverCurrent : 17|1@1+ (1,0) [0|1] "On / Off" Vector__XXX
 SG_ MC_FAULT_HardwareOverCurrent : 16|1@1+ (1,0) [0|1] "On / Off" Vector__XXX
 SG_ MC_ActiveMotor : 32|16@1+ (1,0) [0|0] "" Vector__XXX
 SG_ MC_TxErrorCount : 48|8@1+ (1,0) [0|0] "" Vector__XXX
 SG_ MC_RxErrorCount : 56|8@1+ (1,0) [0|0] "" Vector__XXX

BO_ 1058 MC_BusMeasurement: 8 Prohelion_WaveSculptor22
 SG_ MC_BusVoltage : 0|32@1- (1,0) [0|0] "V" Vector__XXX
 SG_ MC_BusCurrent : 32|32@1- (1,0) [0|0] "A" Vector__XXX

BO_ 1059 MC_VelocityMeasurement: 8 Prohelion_WaveSculptor22
 SG_ MC_MotorVelocity : 0|32@1- (1,0) [0|0] "rpm" Vector__XXX
 SG_ MC_VehicleVelocity : 32|32@1- (1,0) [0|0] "m/s" Vector__XXX

BO_ 1027 MC_ResetCommand: 1 Controls_MotorCommander
 SG_ MC_Reset : 0|8@1+ (1,0) [0|0] "" Vector__XXX

BO_ 1025 MC_DriveCommand: 8 Controls_MotorCommander
 SG_ MC_MotorCurrentSetpoint : 32|32@1- (1,0) [0|1] "%"  Prohelion_WaveSculptor22
 SG_ MC_MotorVelocitySetpoint : 0|32@1- (1,0) [0|12000] "rpm"  Prohelion_WaveSculptor22

BO_ 1060 MC_PhaseCurrentMeasurement: 8 Prohelion_WaveSculptor22
 SG_ MC_PhaseCurrentB : 0|32@1- (1,0) [0|0] "A_rms" Vector__XXX
 SG_ MC_PhaseCurrentC : 32|32@1- (1,0) [0|0] "A_rms" Vector__XXX

BO_ 1061 MC_MotorVoltageVectorMeasurement: 8 Prohelion_WaveSculptor22
 SG_ MC_Vq : 0|32@1- (1,0) [0|0] "V" Vector__XXX
 SG_ MC_Vd : 32|32@1- (1,0) [0|0] "V" Vector__XXX

BO_ 1062 MC_MotorCurrentVectorMeasurement: 8 Prohelion_WaveSculptor22
 SG_ MC_Iq : 0|32@1- (1,0) [0|0] "A" Vector__XXX
 SG_ MC_Id : 32|32@1- (1,0) [0|0] "A" Vector__XXX

BO_ 1063 MC_BackEMFMeasurementPrediction: 8 Prohelion_WaveSculptor22
 SG_ MC_BEMFq : 0|32@1- (1,0) [0|0] "V" Vector__XXX
 SG_ MC_BEMFd : 32|32@1- (1,0) [0|0] "V" Vector__XXX

BO_ 1064 MC_15VRailMeasurement: 8 Prohelion_WaveSculptor22
 SG_ MC_Supply15V : 32|32@1- (1,0) [0|0] "V" Vector__XXX

BO_ 1065 MC_3V319VRailMeasurement: 8 Prohelion_WaveSculptor22
 SG_ MC_Supply1V9 : 0|32@1- (1,0) [0|0] "V" Vector__XXX
 SG_ MC_Supply3V3 : 32|32@1- (1,0) [0|0] "V" Vector__XXX

BO_ 1067 MC_Motor_TempMeasurement: 8 Prohelion_WaveSculptor22
 SG_ MC_MotorTemp : 0|32@1- (1,0) [0|0] "C" Vector__XXX
 SG_ MC_HeatsinkTemp : 32|32@1- (1,0) [0|0] "C" Vector__XXX

BO_ 1068 MC_DspBoardTempMeasurement: 8 Prohelion_WaveSculptor22
 SG_ MC_DspBoardTemp : 0|32@1- (1,0) [0|0] "C" Vector__XXX

BO_ 1070 MC_OdometerBusAhMeasurement: 8 Prohelion_WaveSculptor22
 SG_ MC_TripOdometer : 0|32@1- (1,0) [0|0] "m" Vector__XXX
 SG_ MC_DCBusAh : 32|32@1- (1,0) [0|0] "Ah" Vector__XXX

BO_ 1079 MC_SlipSpeedMeasurement: 8 Prohelion_WaveSculptor22
 SG_ MC_SlipSpeed : 0|32@1- (1,0) [0|0] "Hz" Vector__XXX

CM_ SG_ 1056 MC_TritiumID "Device identifier. 0x00004003";
CM_ SG_ 1056 MC_SerialNumber "Device serial number, allocated at manufacture.";
CM_ SG_ 1057 MC_ActiveMotor "The index of the active motor currently being used.";
CM_ SG_ 1057 MC_TxErrorCount "The DSP CAN transmission error counter (CAN 2.0)";
CM_ SG_ 1057 MC_RxErrorCount "The DSP CAN receive error counter (CAN 2.0)";
CM_ SG_ 1058 MC_BusVoltage "DC bus voltage at the controller.";
CM_ SG_ 1058 MC_BusCurrent "Current drawn from the DC bus by the controller.";
CM_ SG_ 1059 MC_MotorVelocity "Motor angular frequency in revolutions per minute.";
CM_ SG_ 1059 MC_VehicleVelocity "Vehicle velocity in metres / second.";
CM_ SG_ 1060 MC_PhaseCurrentB "RMS current in motor Phase B.";
CM_ SG_ 1060 MC_PhaseCurrentC "RMS current in motor Phase C.";
CM_ SG_ 1061 MC_Vq "Imaginary component of the applied non-rotating voltage vector to the motor.";
CM_ SG_ 1061 MC_Vd "Real component of the applied non-rotating voltage vector to the motor.";
CM_ SG_ 1062 MC_Iq "Imaginary component of the applied non-rotating current vector to the motor. This current produces torque in the motor and should be in phase with the back-EMF of the motor";
CM_ SG_ 1062 MC_Id "Real component of the applied non-rotating current vector to the motor. This vector represents the field current of the motor.";
CM_ SG_ 1063 MC_BEMFq "The peak of the phase to neutral motor voltage.";
CM_ SG_ 1063 MC_BEMFd "By definition this value is always 0V.";
CM_ SG_ 1064 MC_Supply15V "Actual voltage level of the 15V power rail.";
CM_ SG_ 1065 MC_Supply1V9 "Actual voltage level of the 1.9V DSP power rail.";
CM_ SG_ 1065 MC_Supply3V3 "Actual voltage level of the 3.3V power rail.";
CM_ SG_ 1067 MC_MotorTemp "Internal temperature of the motor";
CM_ SG_ 1067 MC_HeatsinkTemp "Internal temperature of Heat-sink (case).";
CM_ SG_ 1068 MC_DspBoardTemp "Temperature of the DSP board.";
CM_ SG_ 1070 MC_TripOdometer "Distance the vehicle has travelled since reset.";
CM_ SG_ 1070 MC_DCBusAh "Charge flow into the controller DC bus from the time of reset.";
CM_ SG_ 1079 MC_SlipSpeed "Slip speed when driving an induction motor.";
BA_DEF_  "DBName" STRING ;
BA_DEF_ BO_  "GenMsgSendType" ENUM  "Cyclic","Event","CyclicAndEvent","CyclicAndEventNoRepetition","None","Spontaneous";
BA_DEF_ BU_  "Timeout" INT 100 100000;
BA_DEF_  "ProtocolType" ENUM  "ISO 11898-2","J1939";
BA_DEF_DEF_  "DBName" "";
BA_DEF_DEF_  "GenMsgSendType" "Cyclic";
BA_DEF_DEF_  "Timeout" 1000;
BA_DEF_DEF_  "ProtocolType" "ISO 11898-2";
BA_ "DBName" "CarCAN";
BA_ "Timeout" BU_ Controls_MotorCommander 250;
BA_ "Timeout" BU_ TPEE_MPPT_B 500;
BA_ "Timeout" BU_ Prohelion_WaveSculptor22 200;
BA_ "Timeout" BU_ TPEE_MPPT_A 500;
BA_ "Timeout" BU_ Power_Precharge 250;
BA_ "Timeout" BU_ Controls_DriverUserInterface 250;
BA_ "Timeout" BU_ BPS_Leader 250;
SIG_VALTYPE_ 1026 MC_MotorPowerSetpoint : 1;
SIG_VALTYPE_ 1058 MC_BusVoltage : 1;
SIG_VALTYPE_ 1058 MC_BusCurrent : 1;
SIG_VALTYPE_ 1059 MC_MotorVelocity : 1;
SIG_VALTYPE_ 1059 MC_VehicleVelocity : 1;
SIG_VALTYPE_ 1025 MC_MotorCurrentSetpoint : 1;
SIG_VALTYPE_ 1025 MC_MotorVelocitySetpoint : 1;
SIG_VALTYPE_ 1060 MC_PhaseCurrentB : 1;
SIG_VALTYPE_ 1060 MC_PhaseCurrentC : 1;
SIG_VALTYPE_ 1061 MC_Vq : 1;
SIG_VALTYPE_ 1061 MC_Vd : 1;
SIG_VALTYPE_ 1062 MC_Iq : 1;
SIG_VALTYPE_ 1062 MC_Id : 1;
SIG_VALTYPE_ 1063 MC_BEMFq : 1;
SIG_VALTYPE_ 1063 MC_BEMFd : 1;
SIG_VALTYPE_ 1064 MC_Supply15V : 1;
SIG_VALTYPE_ 1065 MC_Supply1V9 : 1;
SIG_VALTYPE_ 1065 MC_Supply3V3 : 1;
SIG_VALTYPE_ 1067 MC_MotorTemp : 1;
SIG_VALTYPE_ 1067 MC_HeatsinkTemp : 1;
SIG_VALTYPE_ 1068 MC_DspBoardTemp : 1;
SIG_VALTYPE_ 1070 MC_TripOdometer : 1;
SIG_VALTYPE_ 1070 MC_DCBusAh : 1;
SIG_VALTYPE_ 1079 MC_SlipSpeed : 1;
