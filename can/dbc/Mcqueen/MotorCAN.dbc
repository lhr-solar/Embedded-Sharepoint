VERSION ""

NS_ :

BS_:

BU_: Prohelion_WaveSculptor22 External VCU
VAL_TABLE_ Motor_Command_Source 1 "Tritium External" 0 "VCU" ;
VAL_TABLE_ Generic_Limit 1 "LIMIT" 0 "OK" ;
VAL_TABLE_ Generic_Fault 1 "FAULT" 0 "OK" ;

BO_ 1953 Set_Motor_Cmd_Src: 1 External
 SG_ Motor_Command_Source : 0|1@1+ (1,0) [0|1] "" Vector__XXX

BO_ 1026 MC_PowerCommand: 4 VCU
 SG_ MC_MotorPowerSetpoint : 0|32@1- (1,0) [0|1] "%"  Prohelion_WaveSculptor22

BO_ 1056 MC_Info: 8 Prohelion_WaveSculptor22
 SG_ MC_TritiumID : 0|32@1+ (1,0) [0|0] "" Vector__XXX
 SG_ MC_SerialNumber : 32|32@1+ (1,0) [0|0] "" Vector__XXX

BO_ 1057 MC_Status: 8 Prohelion_WaveSculptor22
 SG_ MC_LIMIT_Reserved : 7|9@1+ (1,0) [0|511] "" Vector__XXX
 SG_ MC_LIMIT_MotorTemp : 6|1@1+ (1,0) [0|1] "" Vector__XXX
 SG_ MC_LIMIT_BusVoltageLower : 5|1@1+ (1,0) [0|1] "" Vector__XXX
 SG_ MC_LIMIT_BusVoltageUpper : 4|1@1+ (1,0) [0|1] "" Vector__XXX
 SG_ MC_LIMIT_BusCurrent : 3|1@1+ (1,0) [0|1] "" Vector__XXX
 SG_ MC_LIMIT_Velocity : 2|1@1+ (1,0) [0|1] "" Vector__XXX
 SG_ MC_LIMIT_MotorCurrent : 1|1@1+ (1,0) [0|1] "" Vector__XXX
 SG_ MC_LIMIT_OutputVoltagePWM : 0|1@1+ (1,0) [0|1] "" Vector__XXX
 SG_ MC_FAULT_Reserved : 25|7@1+ (1,0) [0|0] "" Vector__XXX
 SG_ MC_FAULT_MotorOverSpeed : 24|1@1+ (1,0) [0|1] "" Vector__XXX
 SG_ MC_FAULT_DesaturationFault : 23|1@1+ (1,0) [0|1] "" Vector__XXX
 SG_ MC_FAULT_15vRailUnderVoltage : 22|1@1+ (1,0) [0|1] "" Vector__XXX
 SG_ MC_FAULT_ConfigRead : 21|1@1+ (1,0) [0|1] "" Vector__XXX
 SG_ MC_FAULT_WatchdogCausedLastReset : 20|1@1+ (1,0) [0|1] "" Vector__XXX
 SG_ MC_FAULT_BadMotorPositionHallSeq : 19|1@1+ (1,0) [0|1] "" Vector__XXX
 SG_ MC_FAULT_DcBusOverVoltage : 18|1@1+ (1,0) [0|1] "" Vector__XXX
 SG_ MC_FAULT_SoftwareOverCurrent : 17|1@1+ (1,0) [0|1] "" Vector__XXX
 SG_ MC_FAULT_HardwareOverCurrent : 16|1@1+ (1,0) [0|1] "" Vector__XXX
 SG_ MC_ActiveMotor : 32|16@1+ (1,0) [0|0] "" Vector__XXX
 SG_ MC_TxErrorCount : 48|8@1+ (1,0) [0|0] "" Vector__XXX
 SG_ MC_RxErrorCount : 56|8@1+ (1,0) [0|0] "" Vector__XXX

BO_ 1058 MC_BusMeasurement: 8 Prohelion_WaveSculptor22
 SG_ MC_BusVoltage : 0|32@1- (1,0) [0|0] "V" Vector__XXX
 SG_ MC_BusCurrent : 32|32@1- (1,0) [0|0] "A" Vector__XXX

BO_ 1059 MC_VelocityMeasurement: 8 Prohelion_WaveSculptor22
 SG_ MC_MotorVelocity : 0|32@1- (1,0) [0|0] "rpm" Vector__XXX
 SG_ MC_VehicleVelocity : 32|32@1- (1,0) [0|0] "m/s" Vector__XXX

BO_ 1027 MC_ResetCommand: 1 VCU
 SG_ MC_Reset : 0|8@1+ (1,0) [0|0] "" Vector__XXX

BO_ 1025 MC_DriveCommand: 8 VCU
 SG_ MC_MotorCurrentSetpoint : 32|32@1- (1,0) [0|1] "%"  Prohelion_WaveSculptor22
 SG_ MC_MotorVelocitySetpoint : 0|32@1- (1,0) [0|12000] "rpm"  Prohelion_WaveSculptor22

BO_ 1060 MC_PhaseCurrentMeasurement: 8 Prohelion_WaveSculptor22
 SG_ MC_PhaseCurrentB : 0|32@1- (1,0) [0|0] "A_rms" Vector__XXX
 SG_ MC_PhaseCurrentC : 32|32@1- (1,0) [0|0] "A_rms" Vector__XXX

BO_ 1061 MC_MotorVoltageVectorMeasurement: 8 Prohelion_WaveSculptor22
 SG_ MC_Vq : 0|32@1- (1,0) [0|0] "V" Vector__XXX
 SG_ MC_Vd : 32|32@1- (1,0) [0|0] "V" Vector__XXX

BO_ 1062 MC_MotorCurrentVectorMeasurement: 8 Prohelion_WaveSculptor22
 SG_ MC_Iq : 0|32@1- (1,0) [0|0] "A" Vector__XXX
 SG_ MC_Id : 32|32@1- (1,0) [0|0] "A" Vector__XXX

BO_ 1063 MC_BackEMFMeasurementPrediction: 8 Prohelion_WaveSculptor22
 SG_ MC_BEMFq : 0|32@1- (1,0) [0|0] "V" Vector__XXX
 SG_ MC_BEMFd : 32|32@1- (1,0) [0|0] "V" Vector__XXX

BO_ 1064 MC_15V_RailMeasurement: 8 Prohelion_WaveSculptor22
 SG_ MC_Supply15V : 32|32@1- (1,0) [0|0] "V" Vector__XXX

BO_ 1065 MC_3V3_19V_RailMeasurement: 8 Prohelion_WaveSculptor22
 SG_ MC_Supply1V9 : 0|32@1- (1,0) [0|0] "V" Vector__XXX
 SG_ MC_Supply3V3 : 32|32@1- (1,0) [0|0] "V" Vector__XXX

BO_ 1067 MC_Motor_TempMeasurement: 8 Prohelion_WaveSculptor22
 SG_ MC_MotorTemp : 0|32@1- (1,0) [0|0] "C" Vector__XXX
 SG_ MC_HeatsinkTemp : 32|32@1- (1,0) [0|0] "C" Vector__XXX

BO_ 1068 MC_DspBoardTempMeasurement: 8 Prohelion_WaveSculptor22
 SG_ MC_DspBoardTemp : 0|32@1- (1,0) [0|0] "C" Vector__XXX

BO_ 1070 MC_OdometerBusAhMeasurement: 8 Prohelion_WaveSculptor22
 SG_ MC_TripOdometer : 0|32@1- (1,0) [0|0] "m" Vector__XXX
 SG_ MC_DCBusAh : 32|32@1- (1,0) [0|0] "Ah" Vector__XXX

BO_ 1079 MC_SlipSpeedMeasurement: 8 Prohelion_WaveSculptor22
 SG_ MC_SlipSpeed : 0|32@1- (1,0) [0|0] "Hz" Vector__XXX

CM_ SG_ 1056 MC_TritiumID "Device identifier. 0x00004003";
CM_ SG_ 1056 MC_SerialNumber "Device serial number, allocated at manufacture.";
CM_ SG_ 1057 MC_ActiveMotor "The index of the active motor currently being used.";
CM_ SG_ 1057 MC_TxErrorCount "The DSP CAN transmission error counter (CAN 2.0)";
CM_ SG_ 1057 MC_RxErrorCount "The DSP CAN receive error counter (CAN 2.0)";
CM_ SG_ 1058 MC_BusVoltage "DC bus voltage at the controller.";
CM_ SG_ 1058 MC_BusCurrent "Current drawn from the DC bus by the controller.";
CM_ SG_ 1059 MC_MotorVelocity "Motor angular frequency in revolutions per minute.";
CM_ SG_ 1059 MC_VehicleVelocity "Vehicle velocity in metres / second.";
CM_ SG_ 1060 MC_PhaseCurrentB "RMS current in motor Phase B.";
CM_ SG_ 1060 MC_PhaseCurrentC "RMS current in motor Phase C.";
CM_ SG_ 1061 MC_Vq "Imaginary component of the applied non-rotating voltage vector to the motor.";
CM_ SG_ 1061 MC_Vd "Real component of the applied non-rotating voltage vector to the motor.";
CM_ SG_ 1062 MC_Iq "Imaginary component of the applied non-rotating current vector to the motor. This current produces torque in the motor and should be in phase with the back-EMF of the motor";
CM_ SG_ 1062 MC_Id "Real component of the applied non-rotating current vector to the motor. This vector represents the field current of the motor.";
CM_ SG_ 1063 MC_BEMFq "The peak of the phase to neutral motor voltage.";
CM_ SG_ 1063 MC_BEMFd "By definition this value is always 0V.";
CM_ SG_ 1064 MC_Supply15V "Actual voltage level of the 15V power rail.";
CM_ SG_ 1065 MC_Supply1V9 "Actual voltage level of the 1.9V DSP power rail.";
CM_ SG_ 1065 MC_Supply3V3 "Actual voltage level of the 3.3V power rail.";
CM_ SG_ 1067 MC_MotorTemp "Internal temperature of the motor";
CM_ SG_ 1067 MC_HeatsinkTemp "Internal temperature of Heat-sink (case).";
CM_ SG_ 1068 MC_DspBoardTemp "Temperature of the DSP board.";
CM_ SG_ 1070 MC_TripOdometer "Distance the vehicle has travelled since reset.";
CM_ SG_ 1070 MC_DCBusAh "Charge flow into the controller DC bus from the time of reset.";
CM_ SG_ 1079 MC_SlipSpeed "Slip speed when driving an induction motor.";
BA_DEF_  "DBName" STRING ;
BA_DEF_ BO_  "GenMsgSendType" ENUM  "Cyclic","Event","CyclicAndEvent","CyclicAndEventNoRepetition","None","Spontaneous";
BA_DEF_ BO_  "VFrameFormat" ENUM  "StandardCAN","ExtendedCAN","reserved","J1939PG","reserved","reserved","reserved","reserved","reserved","reserved","reserved","reserved","reserved","reserved","StandardCAN_FD","ExtendedCAN_FD";
BA_DEF_  "BusType" STRING ;
BA_DEF_DEF_  "DBName" "";
BA_DEF_DEF_  "GenMsgSendType" "Cyclic";
BA_DEF_DEF_  "VFrameFormat" "ExtendedCAN_FD";
BA_DEF_DEF_  "BusType" "";
BA_ "BusType" "CAN";
BA_ "DBName" "MotorCAN";
BA_ "VFrameFormat" BO_ 1953 0;
BA_ "VFrameFormat" BO_ 1026 0;
BA_ "VFrameFormat" BO_ 1056 0;
BA_ "VFrameFormat" BO_ 1057 0;
BA_ "VFrameFormat" BO_ 1058 0;
BA_ "VFrameFormat" BO_ 1059 0;
BA_ "VFrameFormat" BO_ 1027 0;
BA_ "VFrameFormat" BO_ 1025 0;
BA_ "VFrameFormat" BO_ 1060 0;
BA_ "VFrameFormat" BO_ 1061 0;
BA_ "VFrameFormat" BO_ 1062 0;
BA_ "VFrameFormat" BO_ 1063 0;
BA_ "VFrameFormat" BO_ 1064 0;
BA_ "VFrameFormat" BO_ 1065 0;
BA_ "VFrameFormat" BO_ 1067 0;
BA_ "VFrameFormat" BO_ 1068 0;
BA_ "VFrameFormat" BO_ 1070 0;
BA_ "VFrameFormat" BO_ 1079 0;
VAL_ 1953 Motor_Command_Source 1 "Tritium External" 0 "VCU" ;
VAL_ 1057 MC_LIMIT_Reserved 1 "LIMIT" 0 "OK" ;
VAL_ 1057 MC_LIMIT_MotorTemp 1 "LIMIT" 0 "OK" ;
VAL_ 1057 MC_LIMIT_BusVoltageLower 1 "LIMIT" 0 "OK" ;
VAL_ 1057 MC_LIMIT_BusVoltageUpper 1 "LIMIT" 0 "OK" ;
VAL_ 1057 MC_LIMIT_BusCurrent 1 "LIMIT" 0 "OK" ;
VAL_ 1057 MC_LIMIT_Velocity 1 "LIMIT" 0 "OK" ;
VAL_ 1057 MC_LIMIT_MotorCurrent 1 "LIMIT" 0 "OK" ;
VAL_ 1057 MC_LIMIT_OutputVoltagePWM 1 "LIMIT" 0 "OK" ;
VAL_ 1057 MC_FAULT_Reserved 1 "FAULT" 0 "OK" ;
VAL_ 1057 MC_FAULT_MotorOverSpeed 1 "FAULT" 0 "OK" ;
VAL_ 1057 MC_FAULT_DesaturationFault 1 "FAULT" 0 "OK" ;
VAL_ 1057 MC_FAULT_15vRailUnderVoltage 1 "FAULT" 0 "OK" ;
VAL_ 1057 MC_FAULT_ConfigRead 1 "FAULT" 0 "OK" ;
VAL_ 1057 MC_FAULT_WatchdogCausedLastReset 1 "FAULT" 0 "OK" ;
VAL_ 1057 MC_FAULT_BadMotorPositionHallSeq 1 "FAULT" 0 "OK" ;
VAL_ 1057 MC_FAULT_DcBusOverVoltage 1 "FAULT" 0 "OK" ;
VAL_ 1057 MC_FAULT_SoftwareOverCurrent 1 "FAULT" 0 "OK" ;
VAL_ 1057 MC_FAULT_HardwareOverCurrent 1 "FAULT" 0 "OK" ;
SIG_VALTYPE_ 1026 MC_MotorPowerSetpoint : 1;
SIG_VALTYPE_ 1058 MC_BusVoltage : 1;
SIG_VALTYPE_ 1058 MC_BusCurrent : 1;
SIG_VALTYPE_ 1059 MC_MotorVelocity : 1;
SIG_VALTYPE_ 1059 MC_VehicleVelocity : 1;
SIG_VALTYPE_ 1025 MC_MotorCurrentSetpoint : 1;
SIG_VALTYPE_ 1025 MC_MotorVelocitySetpoint : 1;
SIG_VALTYPE_ 1060 MC_PhaseCurrentB : 1;
SIG_VALTYPE_ 1060 MC_PhaseCurrentC : 1;
SIG_VALTYPE_ 1061 MC_Vq : 1;
SIG_VALTYPE_ 1061 MC_Vd : 1;
SIG_VALTYPE_ 1062 MC_Iq : 1;
SIG_VALTYPE_ 1062 MC_Id : 1;
SIG_VALTYPE_ 1063 MC_BEMFq : 1;
SIG_VALTYPE_ 1063 MC_BEMFd : 1;
SIG_VALTYPE_ 1064 MC_Supply15V : 1;
SIG_VALTYPE_ 1065 MC_Supply1V9 : 1;
SIG_VALTYPE_ 1065 MC_Supply3V3 : 1;
SIG_VALTYPE_ 1067 MC_MotorTemp : 1;
SIG_VALTYPE_ 1067 MC_HeatsinkTemp : 1;
SIG_VALTYPE_ 1068 MC_DspBoardTemp : 1;
SIG_VALTYPE_ 1070 MC_TripOdometer : 1;
SIG_VALTYPE_ 1070 MC_DCBusAh : 1;
SIG_VALTYPE_ 1079 MC_SlipSpeed : 1;
