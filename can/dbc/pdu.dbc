VERSION ""

NS_ :

BS_:

BU_:

BO_ 5 PDU_Status: 3 Vector__XXX
	SG_ Output_State : 0|14@1+ (1,0) [0|16383] "bitfield" Vector__XXX
	SG_ Fault_State : 14|3@1+ (1,0) [0|7] "bitfield" Vector__XXX

BO_ 6 PDU_Command: 2 Vector__XXX
	SG_ Output_Set : 0|14@1+ (1,0) [0|16383] "bitfield" Vector__XXX

BO_ 99 PDU_Output_Current: 5 Vector__XXX
	SG_ Output : 0|4@1+ (1,0) [0|13] "" Vector__XXX
	SG_ Current : 4|32@1+ (1,0) [0|20000] "mA" Vector__XXX

BO_ 100 PDU_Output_Voltage: 0 Vector__XXX
	SG_ Output : 0|4@1+ (1,0) [0|13] "" Vector__XXX
	SG_ Voltage : 4|32@1+ (1,0) [0|1000000] "mV" Vector__XXX

BO_ 101 PDU_Output_Temperature: 0 Vector__XXX
	SG_ Output : 0|4@1+ (1,0) [0|13] "" Vector__XXX
	SG_ Temperature : 4|32@1+ (1,0) [0|1000000] "mC" Vector__XXX

CM_ BO_ 5 "Power Distribution Unit status (xx Hz)";
CM_ SG_ 5 Output_State "On/Off state for fusebox outputs 1-14";
CM_ SG_ 5 Fault_State "PDU System Fault (TODO: flesh out faults)";
CM_ BO_ 6 "Enable/Disable PDU outputs";
CM_ SG_ 6 Output_Set "Sets output 1-14 to on (1) or off (0)";
CM_ BO_ 99 "Current for single PDU output";
CM_ SG_ 99 Output "Output eFuse ID (1-14)";
CM_ SG_ 99 Current "Current through specified output";
CM_ BO_ 100 "Voltage for single PDU output";
CM_ SG_ 100 Output "Output eFuse ID (1-14)";
CM_ SG_ 100 Voltage "Supply voltage for specified output";
CM_ BO_ 101 "Temperature for single PDU output";
CM_ SG_ 101 Output "Output eFuse ID (1-14)";
CM_ SG_ 101 Temperature "Device temperature for specified output";
BA_DEF_ BO_  "VFrameFormat" ENUM  "StandardCAN","ExtendedCAN","reserved","J1939PG";
BA_DEF_  "DatabaseVersion" STRING ;
BA_DEF_  "BusType" STRING ;
BA_DEF_  "ProtocolType" STRING ;
BA_DEF_  "DatabaseCompiler" STRING ;
BA_DEF_DEF_  "VFrameFormat" "J1939PG";
BA_DEF_DEF_  "DatabaseVersion" "DEMO PLUS";
BA_DEF_DEF_  "BusType" "";
BA_DEF_DEF_  "ProtocolType" "";
BA_DEF_DEF_  "DatabaseCompiler" "";
BA_ "ProtocolType" "J1939";
BA_ "BusType" "CAN";
BA_ "DatabaseCompiler" "CSS ELECTRONICS (WWW.CSSELECTRONICS.COM)";
BA_ "DatabaseVersion" "1.0.0";
