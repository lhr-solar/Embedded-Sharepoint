VERSION ""

NS_ :

BS_:

BU_: GPS

BO_ 2147487936 GPS_Latitude: 4 GPS
 SG_ Latitude : 0|32@1- (0.000001,0) [-90|90] "°" Vector__XXX

BO_ 2147487937 GPS_Longitude: 4 GPS
 SG_ Longitude : 0|32@1- (0.000001,0) [-180|180] "°" Vector__XXX

CM_ "HighNoon GPS (Photon gps_car.dbc / staging HighNoon car IDs). Used by Live View and AWS TCP feed.";
CM_ BO_ 4288 "Signed microdegree latitude from the car DAQ path";
CM_ BO_ 4289 "Signed microdegree longitude from the car DAQ path";

BA_DEF_  "DBName" STRING ;
BA_DEF_ BO_  "VFrameFormat" ENUM  "StandardCAN","ExtendedCAN","reserved","J1939PG","reserved","reserved","reserved","reserved","reserved","reserved","reserved","reserved","reserved","reserved","StandardCAN_FD","ExtendedCAN_FD";
BA_DEF_  "BusType" STRING ;
BA_DEF_DEF_  "DBName" "";
BA_DEF_DEF_  "VFrameFormat" "ExtendedCAN";
BA_DEF_DEF_  "BusType" "";
BA_ "BusType" "CAN";
BA_ "DBName" "GPS";
