VERSION ""

NS_ :

BS_:

BU_: WaveSculptor22 Driver

BO_ 545 Motor_Drive_Command: 8 Driver
 SG_ Motor_Velocity_Setpoint : 0|32@1+ (1,0) [0|0] "rpm" Vector__XXX
 SG_ Motor_Current_Setpoint : 32|32@1+ (1,0) [0|0] "%" Vector__XXX

BO_ 546 Motor_Power_Command: 8 Driver
 SG_ Motor_Power_Setpoint : 32|32@1+ (1,0) [0|0] "%" Vector__XXX

BO_ 576 IDInfo: 8 WaveSculptor22
 SG_ TritiumID : 0|32@1+ (1,0) [0|0] "" Vector__XXX
 SG_ SerialNumber : 32|32@1+ (1,0) [0|0] "" Vector__XXX

BO_ 577 Status: 8 WaveSculptor22
 SG_ LimitOutputVoltagePWM : 0|1@1+ (1,0) [0|1] "On / Off" Vector__XXX
 SG_ LimitMotorCurrent : 1|1@1+ (1,0) [0|1] "On / Off" Vector__XXX
 SG_ LimitVelocity : 2|1@1+ (1,0) [0|1] "On / Off" Vector__XXX
 SG_ LimitBusCurrent : 3|1@1+ (1,0) [0|1] "On / Off" Vector__XXX
 SG_ LimitBusVoltageUpper : 4|1@1+ (1,0) [0|1] "On / Off" Vector__XXX
 SG_ LimitBusVoltageLower : 5|1@1+ (1,0) [0|1] "On / Off" Vector__XXX
 SG_ LimitIpmOrMotorTemp : 6|1@1+ (1,0) [0|1] "On / Off" Vector__XXX
 SG_ LimitReserved : 7|9@1+ (1,0) [0|511] "On / Off" Vector__XXX
 SG_ ErrorHardwareOverCurrent : 16|1@1+ (1,0) [0|1] "On / Off" Vector__XXX
 SG_ ErrorSoftwareOverCurrent : 17|1@1+ (1,0) [0|1] "On / Off" Vector__XXX
 SG_ ErrorDcBusOverVoltage : 18|1@1+ (1,0) [0|1] "On / Off" Vector__XXX
 SG_ ErrorBadMotorPositionHallSeq : 19|1@1+ (1,0) [0|1] "On / Off" Vector__XXX
 SG_ ErrorWatchdogCausedLastReset : 20|1@1+ (1,0) [0|1] "On / Off" Vector__XXX
 SG_ ErrorConfigRead : 21|1@1+ (1,0) [0|1] "On / Off" Vector__XXX
 SG_ Error15vRailUnderVoltage : 22|1@1+ (1,0) [0|1] "On / Off" Vector__XXX
 SG_ ErrorDesaturationFault : 23|1@1+ (1,0) [0|1] "On / Off" Vector__XXX
 SG_ ErrorMotorOverSpeed : 24|1@1+ (1,0) [0|1] "On / Off" Vector__XXX
 SG_ ErrorReserved : 25|7@1+ (1,0) [0|0] "On / Off" Vector__XXX
 SG_ ActiveMotor : 32|16@1+ (1,0) [0|0] "" Vector__XXX
 SG_ TxErrorCount : 48|8@1+ (1,0) [0|0] "" Vector__XXX
 SG_ RxErrorCount : 56|8@1+ (1,0) [0|0] "" Vector__XXX

BO_ 578 BusMeasurement: 8 WaveSculptor22
 SG_ BusVoltage : 0|32@1+ (1,0) [0|100] "V" Vector__XXX
 SG_ BusCurrent : 32|32@1+ (1,0) [0|1000] "A" Vector__XXX

BO_ 579 VelocityMeasurement: 8 WaveSculptor22
 SG_ MotorVelocity : 0|32@1- (1,0) [0|0] "rpm" Vector__XXX
 SG_ VehicleVelocity : 32|32@1- (2.237,0) [0|0] "mph" Vector__XXX

BO_ 580 PhaseCurrentMeasurement: 8 WaveSculptor22
 SG_ PhaseCurrentB : 0|32@1- (1,0) [0|0] "A_rms" Vector__XXX
 SG_ PhaseCurrentC : 32|32@1- (1,0) [0|0] "A_rms" Vector__XXX

BO_ 581 MotorVoltageVectorMeasurement: 8 WaveSculptor22
 SG_ Vq : 0|32@1- (1,0) [0|0] "V" Vector__XXX
 SG_ Vd : 32|32@1- (1,0) [0|0] "V" Vector__XXX

BO_ 582 MotorCurrentVectorMeasurement: 8 WaveSculptor22
 SG_ Iq : 0|32@1- (1,0) [0|0] "A" Vector__XXX
 SG_ Id : 32|32@1- (1,0) [0|0] "A" Vector__XXX

BO_ 583 BackEMFMeasurementPrediction: 8 WaveSculptor22
 SG_ BEMFq : 0|32@1- (1,0) [0|0] "V" Vector__XXX
 SG_ BEMFd : 32|32@1- (1,0) [0|0] "V" Vector__XXX

BO_ 584 VoltageRail15VMeasurement: 8 WaveSculptor22
 SG_ ReservedSupply15V : 0|32@1- (1,0) [0|0] "" Vector__XXX
 SG_ Supply15V : 32|32@1- (1,0) [0|0] "V" Vector__XXX

BO_ 585 VoltageRail3V31V9Measurement: 8 WaveSculptor22
 SG_ Supply1V9 : 0|32@1- (1,0) [0|0] "V" Vector__XXX
 SG_ Supply3V3 : 32|32@1- (1,0) [0|0] "V" Vector__XXX

BO_ 586 Reserved0A: 8 WaveSculptor22
 SG_ Reserved0A0 : 0|32@1- (1,0) [0|0] "" Vector__XXX
 SG_ Reserved0A1 : 32|32@1- (1,0) [0|0] "" Vector__XXX

BO_ 587 HeatsinkMotorTempMeasurement: 8 WaveSculptor22
 SG_ MotorTemp : 0|32@1- (1,0) [0|0] "C" Vector__XXX
 SG_ HeatsinkTemp : 32|32@1- (1,0) [0|0] "C" Vector__XXX

BO_ 588 DspBoardTempMeasurement: 8 WaveSculptor22
 SG_ DspBoardTemp : 0|32@1- (1,0) [0|0] "C" Vector__XXX
 SG_ ReservedDspBoardTemp : 32|32@1- (1,0) [0|0] "" Vector__XXX

BO_ 589 Reserved0D: 8 WaveSculptor22
 SG_ Reserved0D0 : 0|32@1- (1,0) [0|0] "" Vector__XXX
 SG_ Reserved0D1 : 32|32@1- (1,0) [0|0] "" Vector__XXX

BO_ 590 OdometerBusAhMeasurement: 8 WaveSculptor22
 SG_ Odometer : 0|32@1- (1,0) [0|0] "m" Vector__XXX
 SG_ DCBusAh : 32|32@1- (1,0) [0|0] "Ah" Vector__XXX

BO_ 599 SlipSpeedMeasurement: 8 WaveSculptor22
 SG_ SlipSpeed : 0|32@1- (1,0) [0|0] "Hz" Vector__XXX
 SG_ ReservedSlipSpeed : 32|32@1- (1,0) [0|0] "" Vector__XXX

CM_ SG_ 576 TritiumID "Device identifier. 0x00004003";
CM_ SG_ 576 SerialNumber "Device serial number, allocated at manufacture.";
CM_ SG_ 577 ActiveMotor "The index of the active motor currently being used.";
CM_ SG_ 577 TxErrorCount "The DSP CAN transmission error counter (CAN 2.0)";
CM_ SG_ 577 RxErrorCount "The DSP CAN receive error counter (CAN 2.0)";
CM_ SG_ 590 Odometer "Distance the vehicle has travelled since reset.";
CM_ SG_ 590 DCBusAh "Charge flow into the controller DC bus from the time of reset.";
BA_DEF_ BO_  "VFrameFormat" ENUM  "StandardCAN","ExtendedCAN","reserved","J1939PG";
BA_DEF_ BO_  "GenMsgCycleTime" INT 2 50000;
BA_DEF_ BU_  "GenNodAutoGenSnd" ENUM  "No","Yes";
BA_DEF_ BU_  "GenNodAutoGenDsp" ENUM  "No","Yes";
BA_DEF_  "GenEnvVarEndingDsp" STRING ;
BA_DEF_  "GenEnvVarEndingSnd" STRING ;
BA_DEF_  "GenEnvVarPrefix" STRING ;
BA_DEF_  "DatabaseVersion" STRING ;
BA_DEF_DEF_  "GenMsgCycleTime" 100;
BA_DEF_DEF_  "GenNodAutoGenSnd" "Yes";
BA_DEF_DEF_  "GenNodAutoGenDsp" "Yes";
BA_DEF_DEF_  "GenEnvVarEndingDsp" "Dsp";
BA_DEF_DEF_  "GenEnvVarEndingSnd" "Snd";
BA_DEF_DEF_  "GenEnvVarPrefix" "Env";
BA_DEF_DEF_  "DatabaseVersion" "DEMO PLUS";
BA_ "GenMsgCycleTime" BO_ 545 0;
BA_ "VFrameFormat" BO_ 545 3;
BA_ "GenMsgCycleTime" BO_ 546 0;
BA_ "VFrameFormat" BO_ 546 3;
BA_ "GenMsgCycleTime" BO_ 576 1000;
BA_ "VFrameFormat" BO_ 576 0;
BA_ "GenMsgCycleTime" BO_ 577 200;
BA_ "VFrameFormat" BO_ 577 0;
BA_ "VFrameFormat" BO_ 578 0;
BA_ "VFrameFormat" BO_ 579 0;
BA_ "VFrameFormat" BO_ 580 0;
BA_ "VFrameFormat" BO_ 581 0;
BA_ "VFrameFormat" BO_ 582 0;
BA_ "VFrameFormat" BO_ 583 0;
BA_ "VFrameFormat" BO_ 584 0;
BA_ "VFrameFormat" BO_ 585 0;
BA_ "VFrameFormat" BO_ 586 0;
BA_ "VFrameFormat" BO_ 587 0;
BA_ "VFrameFormat" BO_ 588 0;
BA_ "GenMsgCycleTime" BO_ 589 1000;
BA_ "VFrameFormat" BO_ 589 0;
BA_ "GenMsgCycleTime" BO_ 590 1000;
BA_ "VFrameFormat" BO_ 590 0;
BA_ "VFrameFormat" BO_ 599 0;

SIG_VALTYPE_ 545 Motor_Velocity_Setpoint : 1;
SIG_VALTYPE_ 545 Motor_Current_Setpoint : 1;
SIG_VALTYPE_ 546 Motor_Power_Setpoint : 1;
SIG_VALTYPE_ 578 BusVoltage : 1;
SIG_VALTYPE_ 578 BusCurrent : 1;
SIG_VALTYPE_ 579 MotorVelocity : 1;
SIG_VALTYPE_ 579 VehicleVelocity : 1;
SIG_VALTYPE_ 580 PhaseCurrentB : 1;
SIG_VALTYPE_ 580 PhaseCurrentC : 1;
SIG_VALTYPE_ 581 Vq : 1;
SIG_VALTYPE_ 581 Vd : 1;
SIG_VALTYPE_ 582 Iq : 1;
SIG_VALTYPE_ 582 Id : 1;
SIG_VALTYPE_ 583 BEMFq : 1;
SIG_VALTYPE_ 583 BEMFd : 1;
SIG_VALTYPE_ 584 Supply15V : 1;
SIG_VALTYPE_ 585 Supply1V9 : 1;
SIG_VALTYPE_ 585 Supply3V3 : 1;
SIG_VALTYPE_ 587 MotorTemp : 1;
SIG_VALTYPE_ 587 HeatsinkTemp : 1;
SIG_VALTYPE_ 588 DspBoardTemp : 1;
SIG_VALTYPE_ 590 Odometer : 1;
SIG_VALTYPE_ 590 DCBusAh : 1;
