VERSION ""

NS_ :

BS_:

BU_:

BO_ 1536 LV_Carrier_Status: 8 Vector__XXX
	SG_ EngineSpeed : 24|16@1+ (0.125,0) [0|8031.875] "rpm" Vector__XXX

BO_ 1537 Supplemental_Battery_Status: 8 Vector__XXX
	SG_ Supplemental_Battery_Voltage : 0|16@1+ (1,0) [0|40] "V" Vector__XXX
	SG_ Supplemental_Battery_Current : 17|16@1- (1,0) [-2300|28700] "mA" Vector__XXX
	SG_ Supplemental_DCDC_Voltage : 34|16@1+ (1,0) [0|26] "V" Vector__XXX
	SG_ Supplemental_DCDC_Current : 41|0@1- (0,0) [-2300|28700] "mA" Vector__XXX

CM_ SG_ 1536 EngineSpeed "Actual engine speed which is calculated over a minimum crankshaft angle of 720 degrees divided by the number of cylinders.â€¦";
CM_ SG_ 1537 Supplemental_Battery_Voltage "Supplemental Battery voltage in V";
BA_DEF_ SG_  "SPN" INT 0 524287;
BA_DEF_ BO_  "VFrameFormat" ENUM  "StandardCAN","ExtendedCAN","reserved","J1939PG";
BA_DEF_  "DatabaseVersion" STRING ;
BA_DEF_  "BusType" STRING ;
BA_DEF_  "ProtocolType" STRING ;
BA_DEF_  "DatabaseCompiler" STRING ;
BA_DEF_DEF_  "SPN" 0;
BA_DEF_DEF_  "VFrameFormat" "J1939PG";
BA_DEF_DEF_  "DatabaseVersion" "DEMO PLUS";
BA_DEF_DEF_  "BusType" "";
BA_DEF_DEF_  "ProtocolType" "";
BA_DEF_DEF_  "DatabaseCompiler" "";
BA_ "ProtocolType" "J1939";
BA_ "BusType" "CAN";
BA_ "DatabaseCompiler" "CSS ELECTRONICS (WWW.CSSELECTRONICS.COM)";
BA_ "DatabaseVersion" "1.0.0";
BA_ "SPN" SG_ 1536 EngineSpeed 190;
BA_ "SPN" SG_ 1537 WheelBasedVehicleSpeed 84;
